## meta-omur/conf/layer.conf
```bitbake
# We have a conf and classes directory, add to BBPATH
BBPATH .= ":${LAYERDIR}"

# We have recipes-* directories, add to BBFILES
BBFILES += "${LAYERDIR}/recipes-*/*/*.bb \
            ${LAYERDIR}/recipes-*/*/*.bbappend"

BBFILE_COLLECTIONS += "meta-omur"
BBFILE_PATTERN_meta-omur = "^${LAYERDIR}/"
BBFILE_PRIORITY_meta-omur = "6"

LAYERDEPENDS_meta-omur = "core"
LAYERSERIES_COMPAT_meta-omur = "scarthgap"
```
